## conf/layer.conf
```bitbake
# We have a conf and classes directory, add to BBPATH
BBPATH .= ":${LAYERDIR}"

# We have recipes-* directories, add to BBFILES
BBFILES += "${LAYERDIR}/recipes-*/*/*.bb \
            ${LAYERDIR}/recipes-*/*/*.bbappend"

BBFILE_COLLECTIONS += "meta-go001"
BBFILE_PATTERN_meta-go001 = "^${LAYERDIR}/"
BBFILE_PRIORITY_meta-go001 = "6"

LAYERDEPENDS_meta-go001 = "core"
LAYERSERIES_COMPAT_meta-go001 = "scarthgap"
```
